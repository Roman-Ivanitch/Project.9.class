/*****************************************************************************   
 *    Автор: Обушенков Алексей Андреевич 
 *    Группа в ВК https://vk.com/engineer24
 *    Канал на YouTube https://www.youtube.com/channel/UCih0Gcl9IEdkR8deDJCiodg
 *    Инженерка Engineering room
 *    
 *    
 *****************************************************************************
 * Скетч собран по материалам сайта http://docs.blynk.cc/
 *****************************************************************************
 * Модули в составе проекта
 * ESP8266 - 12E WIFI RobotDyn (3.68 $) https://goo.gl/k6TRUz
 * ESP8266 - 12E WIFI GREAT WALL (3.44 $) https://goo.gl/DcqYMg
 *  
 * Датчики для улицы:
 *  DHT 11 (1.00 $) https://goo.gl/sCBn3d  Тут дешево но долго шло
 *  DHT 11 (3.11 $) https://goo.gl/rBFbBD  Тут дороже но дойдет быстрее
 *  Желательно брать этот, скоро будет вариант и с ним.
 *  GY-BME280-3.3 (3.78 $) https://goo.gl/1eyGmg
 *  
 * Модуль часов реального времени
 *  DS3231 Модуль RTC (1.95 $) https://goo.gl/3jMusY
 *  RTC DS3231 (часы реального времени)RobotDyn + аккумулятор (2.90 $) https://goo.gl/gGMRak
 *  
 * Датчики температуры в помещении и в полу
 *  DS18B20 Датчик на плате (2.11 $) https://goo.gl/T4AmmR
 *  DS18B20 Датчик температуры в корпусе (2.07 $) https://goo.gl/HmbgWM
 *  
 * Реле (выбор реле зависит от мощности нагрузки) 
 *  1-канальное реле с управлением Высоким и Низким уровнем 10Ампер (0,99 $) https://goo.gl/SnFuXY
 *  1-канальное реле с управлением Высоким и Низким уровнем 30Ампер (3.96 $) https://goo.gl/PW1uYL
 * 
 *****************************************************************************
 * Библиотеки
 *****************************************************************************
 * BLYNK   
 *    http://docs.blynk.cc/#downloads-blynk-library
 *   
*****************************************************************************
 * В чем суть скетча
 *****************************************************************************
 *  При обрыве Интернета по любой причине, было бы неплохо, что бы наше устройство пере подключилось.
 *  Раздельно отслеживается подключение к WiFi и серверу Blynk.
 *  Есть вкладка Connect.h в ней можно указать каким сервером пользоваться (Основной или Локальный)
 *  Там же задается Токен и Лоин с Паролем от WiFi
 *  Там же все функции отвечающие за подключение.
 *  
 *  Но это не панацея, так как наш ESP8266 однозадачный (однопоточный), то весь скетч будет подвисать
 *  на какое то время при попытке пере подключения.
 *  
 *  К примеру в этом скетче каждые 10 секунд (лучше установить побольше например 30), 
 *  будет проверятся есть ли связь с сервером Blynk и если нет будем пытаться пере подключится,
 *  но если это невозможно (да, да же если и возможно), то 5 секунд, 
 *  а то и больше наша ESP !!! НИЧЕГО НЕ БУДЕТ БОЛЬШЕ ДЕЛАТЬ!!!. Будет только подключаться к Blynk.
 *  Равносильно delay думаю так понятней.
 *  
 *  Если для нашего устройства это не критично, но к примеру нужно реагировать на нажатие кнопки.
 *  Как один из вариантов борьбы с этим повисанием это Прерывания (Interrupt)
 *  Вот и освоим заодно как работать с прерываниями на ESP8266
 */

/* Закомментируйте это, чтобы отключить BLYNK_LOG и сэкономить место */
#define BLYNK_PRINT Serial


#include <ESP8266WiFi.h>
#include <BlynkSimpleEsp8266.h>

// Подключаем вкладку Connect.h
// в ней задаем все свои данные (auth,ssid,pass)
// и выбираем к какому серверу конектиться к Локальному или к Общему
#include "Connect.h" 

// Подключаем вкладку Variables.h там хранятся переменные
#include "Variables.h" 

BlynkTimer timer; // Создаем объект timer 


/////////////////////////////////////////
//            Код программы            //

// Считываем нажатие кнопки
void button()
{
  if(digitalRead(PIN_BUTTON_ZAL)) {
    f_light = !f_light;
    digitalWrite(PIN_RELAY_ZAL, f_light);
    }
}

//// Считываем значение виджета BUTTON (в режиме PUSH) из приложения Блинк
//BLYNK_WRITE(VPIN_BUTTON_ZAL)
//{
//  if (param.asInt()){
//  f_light = !f_light;
//  digitalWrite(PIN_RELAY_ZAL, f_light);
//  }
//}

// Считываем значение виджета BUTTON (в режиме SWITCH) из приложения Блинк
BLYNK_WRITE(VPIN_BUTTON_ZAL)
{
  f_light = param.asInt();
  digitalWrite(PIN_RELAY_ZAL, f_light);
}

  // Считываем и отправляем в Блинк состояние реле
void buttonBlynk()
{

    // Благодаря Last_f_light отправка в Блинк будет происходить, только после
    // изменения флага f_light с прошлого значения на новое
  if (Last_f_light != f_light)
      {
        Last_f_light = f_light;
        Blynk.virtualWrite(VPIN_BUTTON_ZAL, f_light); //отправляем состояние реле в виртуальный пин V8
      }
  
}



void setup()
{
// Настраиваем Входы Выходы МК
  pinMode(PIN_RELAY_ZAL, OUTPUT); //настраиваем пин Реле на выход

// Открываем Сериал монитор
  Serial.begin(9600);

// Задаем прерывания  
/*  Шпаргал по прерываниям http://arduino.ru/Reference/AttachInterrupt */
  
  // Прикрепляем прерывание Для ESP8266
  // У ESP8266 Прерывания могут быть назначены на любые GPIO кроме GPIO16.
  
  // Два способа:
  // 1-й  настраиваем PIN Кнопки на вход с подтяжкой к плюсу 
  // и тип прерывания FALLING (при смене значения на порту с HIGH на LOW)
      //  pinMode(PIN_BUTTON_ZAL, INPUT_PULLUP);
      //  attachInterrupt(digitalPinToInterrupt(PIN_BUTTON_ZAL), button, FALLING);
  
  // 2-й  настраиваем пин Кнопки на вход без подтяжки
  // в этом случае лучше этот пин через резистор на 10кОм притянуть к земле
  // и тип прерывания RISING (при смене значения на порту с LOW на HIGH)
    pinMode(PIN_BUTTON_ZAL, INPUT); 
    attachInterrupt(digitalPinToInterrupt(PIN_BUTTON_ZAL), button, RISING);




// Задаем интервальные таймеры
  timer.setInterval(10000, reconnectBlynk);// Проверяем есть ли связь с сервером
  timer.setInterval(1000L, buttonBlynk);  // Считываем и отправляем в Блинк состояние реле

// Подключаемся к Blynk
    reconnectBlynk(); 
}

void loop()
{
  if (Blynk.connected()){ Blynk.run();}
  timer.run();
}



